## sdkconfig.defaults
```kconfig
# ESP32 sdkconfig defaults for smsgate
# ESP-IDF v5.2 caps this at 60; 120 (config.toml) is enforced by the kick interval
CONFIG_ESP_TASK_WDT_TIMEOUT_S=60
CONFIG_LWIP_DNS_MAX_SERVERS=2
CONFIG_MBEDTLS_CERTIFICATE_BUNDLE=y
CONFIG_ESP_TLS_INSECURE=n
CONFIG_HTTPD_MAX_REQ_HDR_LEN=1024
# Stack size for main task — Rust needs significantly more than the default
CONFIG_ESP_MAIN_TASK_STACK_SIZE=32768
# Enable PSRAM if available (T-A7670X has no PSRAM)
# CONFIG_SPIRAM=n

# ---- Flash size (T-A7670X has 4 MB) ----
CONFIG_ESPTOOLPY_FLASHSIZE_4MB=y

# ---- OTA dual-partition layout ----
# Custom partition table with ~1.94 MB per OTA slot (enough for 1.3 MB firmware).
# The CSV must be converted to .bin via gen_esp32part.py and written to flash at 0x8000.
CONFIG_PARTITION_TABLE_CUSTOM=y
CONFIG_PARTITION_TABLE_CUSTOM_FILENAME="partitions_ota.csv"
CONFIG_PARTITION_TABLE_OFFSET=0x8000
CONFIG_BOOTLOADER_APP_ROLLBACK_ENABLE=y
```
